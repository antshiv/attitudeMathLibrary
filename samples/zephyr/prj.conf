## CMakeLists.txt
```
cmake_minimum_required(VERSION 3.20.0)
find_package(Zephyr REQUIRED HINTS $ENV{ZEPHYR_BASE})
project(attitude_validation)

target_include_directories(app PRIVATE ../../include)
target_sources(app PRIVATE
    src/main.c
    ../../src/euler.c
    ../../src/dcm.c
    ../../src/quaternion.c
    ../../src/vector3.c
    ../../src/attitude_utils.c
    ../../src/validation.c
)
```

## prj.conf
```kconfig
CONFIG_CONSOLE=y
CONFIG_UART_CONSOLE=y
CONFIG_SERIAL=y
CONFIG_NEWLIB_LIBC=y
CONFIG_FPU=y
CONFIG_MAIN_STACK_SIZE=2048
```

## src/main.c
```c
#include <stdint.h>
#include <stdio.h>

#include <zephyr/kernel.h>

#include "attitude/validation.h"

int main(void) {
    const uint32_t failures = attitude_validation_run();
    if (failures == 0u) {
        printf("ATTITUDE_VALIDATION PASS\n");
        return 0;
    }

    printf("ATTITUDE_VALIDATION FAIL mask=0x%08x\n", (unsigned int)failures);
    return 1;
}
```
